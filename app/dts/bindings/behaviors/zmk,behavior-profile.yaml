## app/dts/bindings/behaviors/zmk,behavior-profile.yaml
```yaml
# Copyright (c) 2020 The ZMK Contributors
# SPDX-License-Identifier: MIT

description: Profile Behavior

compatible: "zmk,behavior-profile"

include: two_param.yaml
```
